## linux-live/initramfs/buildroot/mc_defconfig
```kconfig
# Mini Commander initrd toolchain and Unicode terminal library.
BR2_i386=y
BR2_x86_i686=y
BR2_TOOLCHAIN_EXTERNAL=y
BR2_TOOLCHAIN_EXTERNAL_BOOTLIN=y
BR2_TOOLCHAIN_EXTERNAL_BOOTLIN_X86_I686_MUSL_STABLE=y
BR2_STATIC_LIBS=y
BR2_OPTIMIZE_S=y
BR2_TARGET_OPTIMIZATION="-ffunction-sections -fdata-sections"
BR2_TARGET_LDFLAGS="-Wl,--gc-sections"
BR2_INIT_NONE=y
BR2_SYSTEM_BIN_SH_NONE=y
# BR2_PACKAGE_BUSYBOX is not set
BR2_PACKAGE_NCURSES=y
BR2_PACKAGE_NCURSES_WCHAR=y
# BR2_TARGET_ROOTFS_TAR is not set
```
