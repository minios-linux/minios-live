## linux-live/initramfs/buildroot/crypt_tools_defconfig
```kconfig
BR2_i386=y
BR2_x86_i686=y
BR2_TOOLCHAIN_EXTERNAL=y
BR2_TOOLCHAIN_EXTERNAL_BOOTLIN=y
BR2_TOOLCHAIN_EXTERNAL_BOOTLIN_X86_I686_MUSL_STABLE=y
BR2_OPTIMIZE_S=y
BR2_INIT_NONE=y
BR2_SYSTEM_BIN_SH_NONE=y
# BR2_PACKAGE_BUSYBOX is not set
BR2_PACKAGE_CRYPTSETUP=y
# BR2_PACKAGE_LVM2_STANDARD_INSTALL is not set
# BR2_TARGET_ROOTFS_TAR is not set
```

## linux-live/initramfs/buildroot/initrd_tools_defconfig
```kconfig
BR2_i386=y
BR2_x86_i686=y
BR2_TOOLCHAIN_EXTERNAL=y
BR2_TOOLCHAIN_EXTERNAL_BOOTLIN=y
BR2_TOOLCHAIN_EXTERNAL_BOOTLIN_X86_I686_MUSL_STABLE=y
BR2_STATIC_LIBS=y
BR2_OPTIMIZE_S=y
BR2_TARGET_OPTIMIZATION="-ffunction-sections -fdata-sections"
BR2_TARGET_LDFLAGS="-Wl,--gc-sections"
BR2_INIT_NONE=y
BR2_SYSTEM_BIN_SH_NONE=y
# BR2_PACKAGE_BUSYBOX is not set
BR2_PACKAGE_E2FSPROGS=y
BR2_PACKAGE_E2FSPROGS_RESIZE2FS=y
BR2_PACKAGE_JQ=y
BR2_PACKAGE_SQUASHFS=y
BR2_PACKAGE_SQUASHFS_GZIP=y
BR2_PACKAGE_SQUASHFS_LZO=y
BR2_PACKAGE_SQUASHFS_XZ=y
BR2_PACKAGE_SQUASHFS_ZSTD=y
# BR2_TARGET_ROOTFS_TAR is not set
```
